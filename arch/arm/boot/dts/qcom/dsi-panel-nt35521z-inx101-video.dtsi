/* Copyright (c) 2013, The Linux Foundation. All rights reserved.
 *
 * This program is free software; you can redistribute it and/or modify
 * it under the terms of the GNU General Public License version 2 and
 * only version 2 as published by the Free Software Foundation.
 *
 * This program is distributed in the hope that it will be useful,
 * but WITHOUT ANY WARRANTY; without even the implied warranty of
 * MERCHANTABILITY or FITNESS FOR A PARTICULAR PURPOSE.  See the
 * GNU General Public License for more details.
 */

/*---------------------------------------------------------------------------
 * This file is autogenerated file using gcdb parser. Please do not edit it.
 * Update input XML file to add a new entry or update variable in this file
 * VERSION = "1.0"
 *---------------------------------------------------------------------------*/
&mdss_mdp {
	dsi_nt35521z_inx101_video: qcom,mdss_dsi_nt35521z_inx101_video {
		qcom,mdss-dsi-panel-name = "mdss_dsi_nt35521z_inx101_video";
		qcom,mdss-dsi-panel-controller = <&mdss_dsi0>;
		qcom,mdss-dsi-panel-type = "dsi_video_mode";
		qcom,mdss-dsi-panel-destination = "display_1";
		qcom,mdss-dsi-panel-framerate = <58>;
		qcom,mdss-dsi-virtual-channel-id = <0>;
		qcom,mdss-dsi-stream = <0>;
		qcom,mdss-dsi-panel-width = <800>;
		qcom,mdss-dsi-panel-height = <1280>;
		qcom,mdss-dsi-h-front-porch = <200>;
		qcom,mdss-dsi-h-back-porch = <80>;
		qcom,mdss-dsi-h-pulse-width = <4>;
		qcom,mdss-dsi-h-sync-skew = <0>;
		qcom,mdss-dsi-v-back-porch = <20>;
		qcom,mdss-dsi-v-front-porch = <16>;
		qcom,mdss-dsi-v-pulse-width = <4>;
		qcom,mdss-dsi-h-left-border = <0>;
		qcom,mdss-dsi-h-right-border = <0>;
		qcom,mdss-dsi-v-top-border = <0>;
		qcom,mdss-dsi-v-bottom-border = <0>;
		qcom,mdss-dsi-bpp = <24>;
		qcom,mdss-dsi-color-order = "rgb_swap_rgb";
		qcom,mdss-dsi-underflow-color = <0xff>;
		qcom,mdss-dsi-border-color = <0>;
		qcom,mdss-dsi-pixel-packing = "tight";
		qcom,mdss-dsi-pixel-alignment = <0>;
		qcom,mdss-dsi-on-command = [39 01 00 00 00 00 06 F0 55 AA 52 08 00
				39 01 00 00 00 00 03 B1 68 01
				39 01 00 00 00 00 02 B5 C8
				39 01 00 00 00 00 02 BC 00
				39 01 00 00 00 00 06 BD 9E AD 1E 1E 01
				39 01 00 00 00 00 02 C7 01
				39 01 00 00 00 00 02 C7 11
				39 01 00 00 00 00 02 C8 80
				39 01 00 00 00 00 06 F0 55 AA 52 08 01
				39 01 00 00 00 00 03 B3 2B 2B
				39 01 00 00 00 00 03 B4 19 19
				39 01 00 00 00 00 02 BB 15
				39 01 00 00 00 00 02 BC 80
				39 01 00 00 00 00 02 BD 80
				39 01 00 00 00 00 02 BE 29
				39 01 00 00 00 00 06 F0 55 AA 52 08 02
				39 01 00 00 00 00 02 EE 01
				39 01 00 00 00 00 11 B0 00 00 00 22 00 36 00 47 00 56 00 63 00 71 00 7D
				39 01 00 00 00 00 11 B1 00 87 00 B1 00 D6 01 16 01 4A 01 9A 01 D6 01 D7
				39 01 00 00 00 00 11 B2 02 12 02 51 02 79 02 B4 02 DD 02 FF 03 09 03 31
				39 01 00 00 00 00 0D B3 03 45 03 5D 03 7F 03 B5 03 DC 03 FF
				39 01 00 00 00 00 06 F0 55 AA 52 08 03
				39 01 00 00 00 00 06 B2 00 07 04 00 0A
				39 01 00 00 00 00 06 B6 00 80 A3 00 0A
				39 01 00 00 00 00 06 B7 00 A4 A7 00 0A
				39 01 00 00 00 00 05 BA 48 00 00 0A
				39 01 00 00 00 00 05 BB 48 00 00 0A
				39 01 00 00 00 00 04 C0 00 34 00
				39 01 00 00 00 00 04 C1 00 00 34
				39 01 00 00 00 00 06 F0 55 AA 52 08 04
				39 01 00 00 00 00 04 B1 03 02 15
				39 01 00 00 00 00 05 C7 A0 0A 14 03
				39 01 00 00 00 00 02 D3 01
				39 01 00 00 00 00 06 F0 55 AA 52 08 05
				39 01 00 00 00 00 02 B0 06
				39 01 00 00 00 00 02 B1 06
				39 01 00 00 00 00 03 B2 06 00
				39 01 00 00 00 00 06 B3 06 00 00 00 00
				39 01 00 00 00 00 04 B7 06 00 00
				39 01 00 00 00 00 05 BC 00 00 00 01
				39 01 00 00 00 00 06 BD 03 01 03 03 01
				39 01 00 00 00 00 03 C0 05 30
				39 01 00 00 00 00 03 C1 01 31
				39 01 00 00 00 00 04 C4 00 00 3C
				39 01 00 00 00 00 04 C5 00 00 3C
				39 01 00 00 00 00 06 D1 00 05 09 00 00
				39 01 00 00 00 00 06 D2 00 05 0E 00 00
				39 01 00 00 00 00 02 E3 84
				39 01 00 00 00 00 02 E5 1A
				39 01 00 00 00 00 02 E6 1A
				39 01 00 00 00 00 02 E7 1A
				39 01 00 00 00 00 02 E8 1A
				39 01 00 00 00 00 02 E9 1A
				39 01 00 00 00 00 06 F0 55 AA 52 08 06
				39 01 00 00 00 00 06 B0 0B 30 30 30 30
				39 01 00 00 00 00 06 B1 09 2D 2C 1D 1B
				39 01 00 00 00 00 06 B2 19 15 13 11 01
				39 01 00 00 00 00 06 B3 31 30 30 30 30
				39 01 00 00 00 00 06 B4 30 30 30 30 30
				39 01 00 00 00 00 06 B5 00 10 12 14 18
				39 01 00 00 00 00 06 B6 1A 1C 2C 2D 08
				39 01 00 00 00 00 06 B7 30 30 30 30 0A
				39 01 00 00 00 00 06 C0 0A 30 30 30 30
				39 01 00 00 00 00 06 C1 00 2D 2C 10 12
				39 01 00 00 00 00 06 C2 14 18 1A 1C 08
				39 01 00 00 00 00 06 C3 30 30 30 30 30
				39 01 00 00 00 00 06 C4 30 30 30 30 30
				39 01 00 00 00 00 06 C5 09 1D 1B 19 15
				39 01 00 00 00 00 06 C6 13 11 2C 2D 01
				39 01 00 00 00 00 06 C7 30 30 30 30 0B
				39 01 00 00 00 00 05 D1 30 30 30 30
				39 01 00 00 00 00 05 D2 30 30 30 30
				39 01 00 00 00 00 06 F0 55 AA 52 00 00
				05 01 00 00 78 00 02 11 00
				05 01 00 00 14 00 02 29 00];
		qcom,mdss-dsi-off-command = [39 01 00 00 14 00 02 28 00
		39 01 00 00 78 00 02 10 00];
		qcom,mdss-dsi-on-command-state = "dsi_lp_mode";
		qcom,mdss-dsi-off-command-state = "dsi_lp_mode";
		qcom,mdss-dsi-h-sync-pulse = <1>;
		qcom,mdss-dsi-traffic-mode = "burst_mode";
		qcom,mdss-dsi-lane-map = "lane_map_0123";
		qcom,mdss-dsi-bllp-eof-power-mode;
		qcom,mdss-dsi-bllp-power-mode;
		qcom,mdss-dsi-lane-0-state;
		qcom,mdss-dsi-lane-1-state;
		qcom,mdss-dsi-lane-2-state;
		qcom,mdss-dsi-lane-3-state;
		qcom,mdss-dsi-panel-timings = [8B 1E 14 00 44 4A 18 22 19 03 04 00];
		qcom,mdss-dsi-t-clk-post = <0x04>;
		qcom,mdss-dsi-t-clk-pre = <0x1C>;
		qcom,mdss-dsi-bl-min-level = <1>;
		qcom,mdss-dsi-bl-max-level = <255>;
		qcom,mdss-dsi-dma-trigger = "trigger_sw";
		qcom,mdss-dsi-mdp-trigger = "none";
		qcom,mdss-dsi-bl-pmic-control-type = "bl_ctrl_pwm";
		qcom,mdss-dsi-bl-pmic-pwm-frequency = <100>;
		qcom,mdss-dsi-bl-pmic-bank-select = <0>;
		qcom,mdss-dsi-panel-orientation = "180";
		qcom,mdss-dsi-pwm-gpio = <&pm8916_mpps 4 0>;
		qcom,mdss-dsi-reset-sequence = <1 20>, <0 10>, <1 20>;
	};
};
