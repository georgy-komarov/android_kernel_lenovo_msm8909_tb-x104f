/*
 * Copyright (c) 2014, The Linux Foundation. All rights reserved.
 *
 * This program is free software; you can redistribute it and/or modify
 * it under the terms of the GNU General Public License version 2 and
 * only version 2 as published by the Free Software Foundation.
 *
 * This program is distributed in the hope that it will be useful,
 * but WITHOUT ANY WARRANTY; without even the implied warranty of
 * MERCHANTABILITY or FITNESS FOR A PARTICULAR PURPOSE.  See the
 * GNU General Public License for more details.
 */
/*
Date		           Author		    IC 		   Module                   Why
2018-04-01    		 chiguoqing       JD9365       STARRY           add starry LCD for A6005
*/
&mdss_mdp {
	dsi_jd9365_starry_video: qcom,mdss_dsi_jd9365_starry_video {
		qcom,mdss-dsi-panel-name = "mdss_dsi_jd9365_starry_video";
		qcom,mdss-dsi-panel-controller = <&mdss_dsi0>;
		qcom,mdss-dsi-panel-type = "dsi_video_mode";
		qcom,mdss-dsi-panel-destination = "display_1";
		qcom,mdss-dsi-panel-framerate = <58>;
		qcom,mdss-dsi-virtual-channel-id = <0>;
		qcom,mdss-dsi-stream = <0>;
		qcom,mdss-dsi-panel-width = <800>;
		qcom,mdss-dsi-panel-height = <1280>;
		qcom,mdss-dsi-h-front-porch = <180>;
		qcom,mdss-dsi-h-back-porch = <80>;
		qcom,mdss-dsi-h-pulse-width = <4>;
		qcom,mdss-dsi-h-sync-skew = <0>;
		qcom,mdss-dsi-v-front-porch = <16>;
		qcom,mdss-dsi-v-back-porch = <4>;
		qcom,mdss-dsi-v-pulse-width = <4>;
		qcom,mdss-dsi-h-left-border = <0>;
		qcom,mdss-dsi-h-right-border = <0>;
		qcom,mdss-dsi-v-top-border = <0>;
		qcom,mdss-dsi-v-bottom-border = <0>;
		qcom,mdss-dsi-bpp = <24>;
		qcom,mdss-dsi-color-order = <0>;
		qcom,mdss-dsi-underflow-color = <0xff>;
		qcom,mdss-dsi-border-color = <0>;
		qcom,mdss-dsi-pixel-packing = <0>;
		qcom,mdss-dsi-on-command = [
					39 01 00 00 00 00 02 E0 00
					39 01 00 00 00 00 02 E1 93
					39 01 00 00 00 00 02 E2 65
					39 01 00 00 00 00 02 E3 F8
					39 01 00 00 00 00 02 80 03
					39 01 00 00 00 00 02 E0 04
					39 01 00 00 00 00 02 2D 03
					39 01 00 00 00 00 02 E0 00
					39 01 00 00 00 00 02 70 10
					39 01 00 00 00 00 02 71 13
					39 01 00 00 00 00 02 72 06
					39 01 00 00 00 00 02 E0 01
					39 01 00 00 00 00 02 00 00
					39 01 00 00 00 00 02 17 00
					39 01 00 00 00 00 02 18 C2
					39 01 00 00 00 00 02 19 01
					39 01 00 00 00 00 02 1A 00
					39 01 00 00 00 00 02 1B C2
					39 01 00 00 00 00 02 1C 01
					39 01 00 00 00 00 02 1F 3F
					39 01 00 00 00 00 02 20 24
					39 01 00 00 00 00 02 21 24
					39 01 00 00 00 00 02 22 0E
					39 01 00 00 00 00 02 35 28
					39 01 00 00 00 00 02 37 09
					39 01 00 00 00 00 02 38 04
					39 01 00 00 00 00 02 39 00
					39 01 00 00 00 00 02 3A 01
					39 01 00 00 00 00 02 3C 78
					39 01 00 00 00 00 02 3D FF
					39 01 00 00 00 00 02 3E FF
					39 01 00 00 00 00 02 3F FF
					39 01 00 00 00 00 02 4B 04
					39 01 00 00 00 00 02 40 06
					39 01 00 00 00 00 02 41 A0
					39 01 00 00 00 00 02 43 08
					39 01 00 00 00 00 02 44 07
					39 01 00 00 00 00 02 45 24
					39 01 00 00 00 00 02 55 01
					39 01 00 00 00 00 02 56 01
					39 01 00 00 00 00 02 57 69
					39 01 00 00 00 00 02 58 0A
					39 01 00 00 00 00 02 59 2A
					39 01 00 00 00 00 02 5A 28
					39 01 00 00 00 00 02 5B 0F
					39 01 00 00 00 00 02 5C 15
					39 01 00 00 00 00 02 5D 7C
					39 01 00 00 00 00 02 5E 67
					39 01 00 00 00 00 02 5F 55
					39 01 00 00 00 00 02 60 48
					39 01 00 00 00 00 02 61 3E
					39 01 00 00 00 00 02 62 2D
					39 01 00 00 00 00 02 63 30
					39 01 00 00 00 00 02 64 16
					39 01 00 00 00 00 02 65 2C
					39 01 00 00 00 00 02 66 28
					39 01 00 00 00 00 02 67 26
					39 01 00 00 00 00 02 68 42
					39 01 00 00 00 00 02 69 30
					39 01 00 00 00 00 02 6A 38
					39 01 00 00 00 00 02 6B 29
					39 01 00 00 00 00 02 6C 26
					39 01 00 00 00 00 02 6D 1C
					39 01 00 00 00 00 02 6E 0D
					39 01 00 00 00 00 02 6F 00
					39 01 00 00 00 00 02 70 7C
					39 01 00 00 00 00 02 71 69
					39 01 00 00 00 00 02 72 55
					39 01 00 00 00 00 02 73 48
					39 01 00 00 00 00 02 74 3E
					39 01 00 00 00 00 02 75 2D
					39 01 00 00 00 00 02 76 30
					39 01 00 00 00 00 02 77 16
					39 01 00 00 00 00 02 78 2C
					39 01 00 00 00 00 02 79 28
					39 01 00 00 00 00 02 7A 26
					39 01 00 00 00 00 02 7B 42
					39 01 00 00 00 00 02 7C 30
					39 01 00 00 00 00 02 7D 38
					39 01 00 00 00 00 02 7E 29
					39 01 00 00 00 00 02 7F 26
					39 01 00 00 00 00 02 80 1C
					39 01 00 00 00 00 02 81 0D
					39 01 00 00 00 00 02 82 00
					39 01 00 00 00 00 02 E0 02
					39 01 00 00 00 00 02 00 09
					39 01 00 00 00 00 02 01 05
					39 01 00 00 00 00 02 02 08
					39 01 00 00 00 00 02 03 04
					39 01 00 00 00 00 02 04 06
					39 01 00 00 00 00 02 05 0A
					39 01 00 00 00 00 02 06 07
					39 01 00 00 00 00 02 07 0B
					39 01 00 00 00 00 02 08 00
					39 01 00 00 00 00 02 09 1F
					39 01 00 00 00 00 02 0A 1F
					39 01 00 00 00 00 02 0B 1F
					39 01 00 00 00 00 02 0C 1F
					39 01 00 00 00 00 02 0D 1F
					39 01 00 00 00 00 02 0E 1F
					39 01 00 00 00 00 02 0F 17
					39 01 00 00 00 00 02 10 37
					39 01 00 00 00 00 02 11 1F
					39 01 00 00 00 00 02 12 1F
					39 01 00 00 00 00 02 13 1E
					39 01 00 00 00 00 02 14 10
					39 01 00 00 00 00 02 15 1F
					39 01 00 00 00 00 02 16 09
					39 01 00 00 00 00 02 17 05
					39 01 00 00 00 00 02 18 08
					39 01 00 00 00 00 02 19 04
					39 01 00 00 00 00 02 1A 06
					39 01 00 00 00 00 02 1B 0A
					39 01 00 00 00 00 02 1C 07
					39 01 00 00 00 00 02 1D 0B
					39 01 00 00 00 00 02 1E 00
					39 01 00 00 00 00 02 1F 1F
					39 01 00 00 00 00 02 20 1F
					39 01 00 00 00 00 02 21 1F
					39 01 00 00 00 00 02 22 1F
					39 01 00 00 00 00 02 23 1F
					39 01 00 00 00 00 02 24 1F
					39 01 00 00 00 00 02 25 17
					39 01 00 00 00 00 02 26 37
					39 01 00 00 00 00 02 27 1F
					39 01 00 00 00 00 02 28 1F
					39 01 00 00 00 00 02 29 1E
					39 01 00 00 00 00 02 2A 10
					39 01 00 00 00 00 02 2B 1F
					39 01 00 00 00 00 02 2C 06
					39 01 00 00 00 00 02 2D 0A
					39 01 00 00 00 00 02 2E 07
					39 01 00 00 00 00 02 2F 0B
					39 01 00 00 00 00 02 30 09
					39 01 00 00 00 00 02 31 05
					39 01 00 00 00 00 02 32 08
					39 01 00 00 00 00 02 33 04
					39 01 00 00 00 00 02 34 10
					39 01 00 00 00 00 02 35 1F
					39 01 00 00 00 00 02 36 1F
					39 01 00 00 00 00 02 37 1F
					39 01 00 00 00 00 02 38 1F
					39 01 00 00 00 00 02 39 1F
					39 01 00 00 00 00 02 3A 1F
					39 01 00 00 00 00 02 3B 17
					39 01 00 00 00 00 02 3C 37
					39 01 00 00 00 00 02 3D 1F
					39 01 00 00 00 00 02 3E 1E
					39 01 00 00 00 00 02 3F 1F
					39 01 00 00 00 00 02 40 00
					39 01 00 00 00 00 02 41 1F
					39 01 00 00 00 00 02 42 06
					39 01 00 00 00 00 02 43 0A
					39 01 00 00 00 00 02 44 07
					39 01 00 00 00 00 02 45 0B
					39 01 00 00 00 00 02 46 09
					39 01 00 00 00 00 02 47 05
					39 01 00 00 00 00 02 48 08
					39 01 00 00 00 00 02 49 04
					39 01 00 00 00 00 02 4A 10
					39 01 00 00 00 00 02 4B 1F
					39 01 00 00 00 00 02 4C 1F
					39 01 00 00 00 00 02 4D 1F
					39 01 00 00 00 00 02 4E 1F
					39 01 00 00 00 00 02 4F 1F
					39 01 00 00 00 00 02 50 1F
					39 01 00 00 00 00 02 51 17
					39 01 00 00 00 00 02 52 37
					39 01 00 00 00 00 02 53 1F
					39 01 00 00 00 00 02 54 1E
					39 01 00 00 00 00 02 55 1F
					39 01 00 00 00 00 02 56 00
					39 01 00 00 00 00 02 57 1F
					39 01 00 00 00 00 02 58 01
					39 01 00 00 00 00 02 59 00
					39 01 00 00 00 00 02 5A 00
					39 01 00 00 00 00 02 5B 00
					39 01 00 00 00 00 02 5C 01
					39 01 00 00 00 00 02 5D 70
					39 01 00 00 00 00 02 5E 00
					39 01 00 00 00 00 02 5F 00
					39 01 00 00 00 00 02 60 40
					39 01 00 00 00 00 02 61 00
					39 01 00 00 00 00 02 62 00
					39 01 00 00 00 00 02 63 65
					39 01 00 00 00 00 02 64 65
					39 01 00 00 00 00 02 65 45
					39 01 00 00 00 00 02 66 09
					39 01 00 00 00 00 02 67 73
					39 01 00 00 00 00 02 68 05
					39 01 00 00 00 00 02 69 00
					39 01 00 00 00 00 02 6A 64
					39 01 00 00 00 00 02 6B 00
					39 01 00 00 00 00 02 6C 00
					39 01 00 00 00 00 02 6D 00
					39 01 00 00 00 00 02 6E 00
					39 01 00 00 00 00 02 6F 08   //88
					39 01 00 00 00 00 02 70 00
					39 01 00 00 00 00 02 71 00
					39 01 00 00 00 00 02 72 06
					39 01 00 00 00 00 02 73 7B
					39 01 00 00 00 00 02 74 00
					39 01 00 00 00 00 02 75 80
					39 01 00 00 00 00 02 76 00
					39 01 00 00 00 00 02 77 05
					39 01 00 00 00 00 02 78 18
					39 01 00 00 00 00 02 79 00
					39 01 00 00 00 00 02 7A 00
					39 01 00 00 00 00 02 7B 00
					39 01 00 00 00 00 02 7C 00
					39 01 00 00 00 00 02 7D 03
					39 01 00 00 00 00 02 7E 7B
					39 01 00 00 00 00 02 E0 04
					39 01 00 00 00 00 02 09 14 //10
					39 01 00 00 00 00 02 2B 2B
					39 01 00 00 00 00 02 2E 44
					39 01 00 00 00 00 02 E0 00
					39 01 00 00 00 00 02 E6 02
					39 01 00 00 00 00 02 E7 02
					//39 01 00 00 00 00 02 E0 01
					//39 01 00 00 00 00 02 4A 35
					//39 01 00 00 00 00 02 E0 00
					05 01 00 00 78 00 02 11 00
					05 01 00 00 14 00 02 29 00
					];
		qcom,mdss-dsi-off-command = [
					39 01 00 00 01 00 02 E0 00
					39 01 00 00 00 00 02 E1 93
					39 01 00 00 00 00 02 E2 65
					39 01 00 00 00 00 02 E3 F8
					39 01 00 00 14 00 02 28 00
					39 01 00 00 78 00 02 10 00];
		qcom,mdss-dsi-on-command-state = "dsi_lp_mode";
		qcom,mdss-dsi-off-command-state = "dsi_ls_mode";
		qcom,mdss-dsi-lp11-init;
		qcom,mdss-dsi-h-sync-pulse = <1>;
		qcom,mdss-dsi-traffic-mode = "burst_mode";
		qcom,mdss-dsi-hfp-power-mode;
		qcom,mdss-dsi-lane-map = "lane_map_0123";
		qcom,mdss-dsi-bllp-eof-power-mode;
		qcom,mdss-dsi-bllp-power-mode;
		qcom,mdss-dsi-dma-trigger = <4>;
		qcom,mdss-dsi-mdp-trigger = <0>;
		qcom,mdss-dsi-lane-0-state;
		qcom,mdss-dsi-lane-1-state;
		qcom,mdss-dsi-lane-2-state;
		qcom,mdss-dsi-lane-3-state;
		qcom,mdss-dsi-panel-timings = [8B 1E 14 00 44 46 18 20 19 03 04 00];
		qcom,mdss-dsi-t-clk-post = <0x04>;
		qcom,mdss-dsi-t-clk-pre = <0x28>;
		qcom,mdss-dsi-bl-min-level = <1>;
		qcom,mdss-dsi-bl-max-level = <255>;
		qcom,mdss-dsi-bl-pmic-control-type = "bl_ctrl_pwm";
		qcom,mdss-dsi-bl-pmic-pwm-frequency = <100>;
		qcom,mdss-dsi-bl-pmic-bank-select = <0>;
		qcom,mdss-dsi-panel-orientation = "180";
		qcom,mdss-dsi-pwm-gpio = <&pm8916_mpps 4 0>;
		qcom,mdss-dsi-reset-sequence = <1 20>, <0 10>, <1 20>;
	};
};
